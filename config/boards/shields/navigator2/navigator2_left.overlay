#include "navigator2.dtsi"

&kscan0 {
    col-gpios
        = <&pro_micro_d 3 GPIO_ACTIVE_HIGH> // col1 in the schematic
        , <&pro_micro_d 4 GPIO_ACTIVE_HIGH> // col2 in the schematic
        , <&pro_micro_d 5 GPIO_ACTIVE_HIGH> // col3 in the schematic
        , <&pro_micro_d 6 GPIO_ACTIVE_HIGH> // col4 in the schematic
        , <&pro_micro_d 7 GPIO_ACTIVE_HIGH> // col5 in the schematic
        , <&pro_micro_d 8 GPIO_ACTIVE_HIGH> // col6 in the schematic
        , <&pro_micro_d 9 GPIO_ACTIVE_HIGH> // col7 in the schematic
        , <&pro_micro_d 10 GPIO_ACTIVE_HIGH> // col8 in the schematic
        ;
};