## config/boards/shields/navigator2/Kconfig.defconfig
```kconfig
if SHIELD_NAVIGATOR2_LEFT

config ZMK_KEYBOARD_NAME
  default "navigator2l"

endif

if SHIELD_NAVIGATOR2_RIGHT

config ZMK_KEYBOARD_NAME
  default "navigator2r"

endif
```

## config/boards/shields/navigator2/Kconfig.shield
```kconfig
config SHIELD_NAVIGATOR2_LEFT
    def_bool $(shields_list_contains,navigator2_left)

config SHIELD_NAVIGATOR2_RIGHT
    def_bool $(shields_list_contains,navigator2_right)
```

## config/boards/shields/navigatorLP/Kconfig.defconfig
```kconfig
if SHIELD_NAVIGATORLP_LEFT

config ZMK_KEYBOARD_NAME
  default "navigatorLP"

endif

if SHIELD_NAVIGATORLP_RIGHT

config ZMK_KEYBOARD_NAME
  default "navigatorLPr"

endif
```

## config/boards/shields/navigatorLP/Kconfig.shield
```kconfig
config SHIELD_NAVIGATORLP_LEFT
    def_bool $(shields_list_contains,navigatorLP_left)

config SHIELD_NAVIGATORLP_RIGHT
    def_bool $(shields_list_contains,navigatorLP_right)
```

## config/boards/shields/navigatorLPv2/Kconfig.shield
```kconfig
config SHIELD_NAVIGATORLPV2_LEFT
    def_bool $(shields_list_contains,navigatorLPv2_left)

config SHIELD_NAVIGATORLPV2_RIGHT
    def_bool $(shields_list_contains,navigatorLPv2_right)
```
