## boards/shields/navigatorLPv4/Kconfig.defconfig
```kconfig
if SHIELD_NAVIGATORLPV4_LEFT

config ZMK_KEYBOARD_NAME
  default "navigatorLP4l"
config ZMK_SPLIT_ROLE_CENTRAL
    default y

endif

if SHIELD_NAVIGATORLPV4_RIGHT

config ZMK_KEYBOARD_NAME
  default "navigatorLP4"

endif

if SHIELD_NAVIGATORLPV4_LEFT || SHIELD_NAVIGATORLPV4_RIGHT

config ZMK_SPLIT
    default y

endif
```

## config/boards/shields/navigatorLPv2/Kconfig.defconfig
```kconfig
if SHIELD_NAVIGATORLPV2_LEFT

config ZMK_KEYBOARD_NAME
  default "navigatorLP2"

endif

if SHIELD_NAVIGATORLPV2_RIGHT

config ZMK_KEYBOARD_NAME
  default "navigatorLP2r"
config ZMK_SPLIT_ROLE_CENTRAL
    default y

endif

if SHIELD_NAVIGATORLPV2_LEFT || SHIELD_NAVIGATORLPV2_RIGHT

config ZMK_SPLIT
    default y

endif
```

## config/boards/shields/navigatorLPv4/Kconfig.shield
```kconfig
config SHIELD_NAVIGATORLPV4_LEFT
    def_bool $(shields_list_contains,navigatorLPv4_left)

config SHIELD_NAVIGATORLPV4_RIGHT
    def_bool $(shields_list_contains,navigatorLPv4_right)
```
